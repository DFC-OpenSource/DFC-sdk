## ISSD-SDK-20160701-yocto/LS2085A-SDK-20160304-yocto/meta-linaro/meta-linaro-integration/conf/layer.conf
```bitbake
BBPATH .= ":${LAYERDIR}"
BBFILES += "\
            ${LAYERDIR}/recipes-*/*/*.bb \
            ${LAYERDIR}/recipes-*/*/*.bbappend \
           "

BBFILE_COLLECTIONS += "linaro-integration"
BBFILE_PATTERN_linaro-integration := "^${LAYERDIR}/"
BBFILE_PRIORITY_linaro-integration = "30"

# do not error out on bbappends for missing recipes
BB_DANGLINGAPPENDS_WARNONLY = "true"

SIGGEN_EXCLUDE_SAFE_RECIPE_DEPS += " \
  gcc-cross-${TARGET_ARCH}->glibc \
"
```

## ISSD-SDK-20160701-yocto/LS2085A-SDK-20160304-yocto/meta-linaro/meta-linaro-toolchain/conf/distro/include/tcmode-external-linaro.inc
```bitbake
#
# Configuration to use an external Linaro binary toolchain
#

EXTERNAL_TOOLCHAIN ?= "/usr/local/linaro-binary-toolchain/${TARGET_ARCH}"

TOOLCHAIN_PATH_ADD = "${EXTERNAL_TOOLCHAIN}/bin:"
PATH =. "${TOOLCHAIN_PATH_ADD}"

ELT_TARGET_SYS_arm ?= "arm-linux-gnueabihf"
ELT_TARGET_SYS_aarch64 ?= "aarch64-linux-gnu"
ELT_TARGET_SYS = "${TARGET_SYS}"
TARGET_PREFIX = "${ELT_TARGET_SYS}-"

GCCMULTILIB_forcevariable = "--disable-multilib"
IMAGE_LINGUAS_forcevariable = ""

PREFERRED_PROVIDER_linux-libc-headers = "external-linaro-toolchain"
PREFERRED_PROVIDER_linux-libc-headers-dev = "external-linaro-toolchain"
PREFERRED_PROVIDER_virtual/${TARGET_PREFIX}gcc = "external-linaro-toolchain"
PREFERRED_PROVIDER_virtual/${TARGET_PREFIX}gcc-initial = "external-linaro-toolchain"
PREFERRED_PROVIDER_virtual/${TARGET_PREFIX}g++ = "external-linaro-toolchain"
PREFERRED_PROVIDER_virtual/${TARGET_PREFIX}binutils = "external-linaro-toolchain"
PREFERRED_PROVIDER_virtual/${TARGET_PREFIX}libc-for-gcc = "external-linaro-toolchain"
PREFERRED_PROVIDER_virtual/${TARGET_PREFIX}compilerlibs = "external-linaro-toolchain"
PREFERRED_PROVIDER_glibc = "external-linaro-toolchain"
PREFERRED_PROVIDER_libgcc = "external-linaro-toolchain"
PREFERRED_PROVIDER_virtual/libc = "external-linaro-toolchain"
PREFERRED_PROVIDER_virtual/libintl = "external-linaro-toolchain"
PREFERRED_PROVIDER_virtual/libiconv = "external-linaro-toolchain"
PREFERRED_PROVIDER_glibc-thread-db = "external-linaro-toolchain"
PREFERRED_PROVIDER_glibc-mtrace = "external-linaro-toolchain"
PREFERRED_PROVIDER_libc-mtrace = "external-linaro-toolchain"
PREFERRED_PROVIDER_virtual/linux-libc-headers = "external-linaro-toolchain"

TARGET_CPPFLAGS_prepend = " -isystem${EXTERNAL_TOOLCHAIN}/${ELT_TARGET_SYS}/include "
TARGET_LDFLAGS_prepend = " -L${EXTERNAL_TOOLCHAIN}/${ELT_TARGET_SYS}/lib -Wl,-rpath-link,${EXTERNAL_TOOLCHAIN}/${ELT_TARGET_SYS}/lib "

TOOLCHAIN_OPTIONS = " --sysroot=${STAGING_DIR_HOST}"

DISTRO_FEATURES_LIBC = "ipv4 ipv6 libc-backtrace libc-big-macros libc-bsd libc-cxx-tests libc-catgets libc-crypt \
			libc-crypt-ufc libc-db-aliases libc-envz libc-fcvt libc-fmtmsg libc-fstab libc-ftraverse \
			libc-getlogin libc-idn libc-inet-anl libc-libm libc-libm-big \
			libc-memusage libc-nis libc-nsswitch libc-rcmd libc-rtld-debug libc-spawn libc-streams libc-sunrpc \
			libc-utmp libc-utmpx libc-wordexp libc-posix-clang-wchar libc-posix-regexp libc-posix-regexp-glibc \
			libc-posix-wchar-io"

ENABLE_BINARY_LOCALE_GENERATION = "0"
GLIBC_INTERNAL_USE_BINARY_LOCALE = "precompiled"

ERROR_QA[type] ?= "list"
python toolchain_metadata_setup () {
    import subprocess
    if not isinstance(e, bb.event.ConfigParsed):
        return

    d = e.data
    l = d.createCopy()
    l.finalize()
    oe_import(l)

    external_toolchain = l.getVar('EXTERNAL_TOOLCHAIN', True)
    if not external_toolchain or external_toolchain == 'UNDEFINED':
        bb.fatal("Error: EXTERNAL_TOOLCHAIN must be set to the path to your linaro toolchain")

    if not os.path.exists(external_toolchain):
        bb.fatal("Error: EXTERNAL_TOOLCHAIN path '%s' does not exist" % external_toolchain)

    # The external toolchain may not have been built with the oe-core preferred
    # gnu hash setting, so ensure that the corresponding sanity check is not an error.
    error_qa = oe.data.typed_value('ERROR_QA', l)
    if 'ldflags' in error_qa:
        error_qa.remove('ldflags')
        d.setVar('ERROR_QA', ' '.join(error_qa))
}
addhandler toolchain_metadata_setup

def populate_toolchain_links(d):
    import errno
    import os
    from glob import glob

    d = d.createCopy()
    d.finalize()

    pattern = bb.data.expand('${EXTERNAL_TOOLCHAIN}/bin/${TARGET_PREFIX}*', d)
    files = glob(pattern)
    if not files:
        bb.fatal("Unable to populate toolchain binary symlinks")

    bindir = d.getVar('STAGING_BINDIR_TOOLCHAIN', True)
    bb.mkdirhier(bindir)
    for f in files:
        base = os.path.basename(f)
        newpath = os.path.join(bindir, base)
        try:
            os.symlink(f, newpath)
        except OSError as exc:
            if exc.errno == errno.EEXIST:
                break
            bb.fatal("Unable to populate toolchain binary symlink for %s: %s" % (newpath, exc))

require conf/distro/include/external-linaro-toolchain-versions.inc
```

## ISSD-SDK-20160701-yocto/LS2085A-SDK-20160304-yocto/meta-linaro/meta-linaro/conf/layer.conf
```bitbake
BBPATH .= ":${LAYERDIR}"
BBFILES += "\
            ${LAYERDIR}/recipes-*/*/*.bb \
            ${LAYERDIR}/recipes-*/*/*.bbappend \
           "

BBFILE_COLLECTIONS += "linaro"
BBFILE_PATTERN_linaro := "^${LAYERDIR}/"
BBFILE_PRIORITY_linaro = "25"

# do not error out on bbappends for missing recipes (mysql5)
BB_DANGLINGAPPENDS_WARNONLY = "true"

# we need meta-networking for (lib)memcached
LAYERDEPENDS_linaro = "networking-layer"
```

## ISSD-SDK-20160701-yocto/LS2085A-SDK-20160304-yocto/meta-linaro/meta-linaro/conf/machine/genericarmv7ab.conf
```bitbake
#@TYPE: Machine
#@NAME: generic armv7a big endian machine
#@DESCRIPTION: generic machine to be used by linaro-media-create

DEFAULTTUNE ?= "armv7ab"

require conf/machine/genericarmv7a.conf
```

## ISSD-SDK-20160701-yocto/LS2085A-SDK-20160304-yocto/meta-linaro/meta-linaro/conf/machine/lng-rt-x86-64.conf
```bitbake
include lng.inc
DEFAULTTUNE = "core2-64"
require conf/machine/include/tune-core2.inc
PREFERRED_PROVIDER_virtual/kernel = "linaro-lng-rt-x86-64"
```

## ISSD-SDK-20160701-yocto/LS2085A-SDK-20160304-yocto/meta-linaro/meta-linaro/conf/machine/lng-x86-64.conf
```bitbake
include lng.inc
DEFAULTTUNE = "core2-64"
require conf/machine/include/tune-core2.inc
PREFERRED_PROVIDER_virtual/kernel = "linaro-lng-x86-64"
```

## ISSD-SDK-20160701-yocto/LS2085A-SDK-20160304-yocto/meta-linaro/meta-linaro/conf/machine/lng.inc
```bitbake
KERNEL_IMAGETYPE = "bzImage"

MACHINE_FEATURES += "x86"

EXTRA_IMAGE_FEATURES += "autoserial"
FEATURE_PACKAGES_autoserial = "auto-serial-console"
```

## Kernel_src/drivers/soc/fsl/ls2-console/Kconfig
```kconfig
config FSL_LS2_CONSOLE
        tristate "Layerscape MC and AIOP console support"
	depends on SOC_LS1021A || ARCH_LAYERSCAPE
        default y
```

## Uboot_src/board/freescale/ls2080aqds/Kconfig
```kconfig
if TARGET_LS2080AQDS

config SYS_BOARD
	default "ls2080aqds"

config SYS_VENDOR
	default "freescale"

config SYS_SOC
	default "fsl-lsch3"

config SYS_CONFIG_NAME
	default "ls2080aqds"

endif
```

## kernel/drivers/dma/dpaa2-qdma/Kconfig
```kconfig
menuconfig FSL_DPAA2_QDMA
	tristate "NXP DPAA2 QDMA"
	depends on FSL_MC_BUS && FSL_MC_DPIO
	select DMA_ENGINE
	select DMA_VIRTUAL_CHANNELS
	---help---
	  NXP Data Path Acceleration Architecture 2 QDMA driver,
	  using the NXP MC bus driver.

config FSL_DPAA2_QDMA_USERSPACE
	tristate "NXP DPAA2 QDMA USERSPACE"
	depends on FSL_DPAA2_QDMA
	---help---
	  Kernel thread which will do QDMA for user space applications.
```

## u-boot/board/freescale/ls2080ardb/Kconfig
```kconfig
if TARGET_LS2080ARDB

config SYS_BOARD
	default "ls2080ardb"

config SYS_VENDOR
	default "freescale"

config SYS_SOC
	default "fsl-lsch3"

config SYS_CONFIG_NAME
	default "ls2080ardb"

endif
```

## u-boot/board/freescale/ls2085aissd/Kconfig
```kconfig
if TARGET_LS2085AISSD

config SYS_BOARD
	default "ls2085aissd"

config SYS_VENDOR
	default "freescale"

config SYS_SOC
	default "fsl-lsch3"

config SYS_CONFIG_NAME
	default "ls2085aissd"

endif
```

## u-boot/board/freescale/ls2088aissd/Kconfig
```kconfig
if TARGET_LS2088AISSD

config SYS_BOARD
	default "ls2088aissd"

config SYS_VENDOR
	default "freescale"

config SYS_SOC
	default "fsl-layerscape"

config SYS_CONFIG_NAME
	default "ls2088aissd"

endif
```

## u-boot/configs/ls1088aemu_defconfig
```kconfig
CONFIG_ARM=y
CONFIG_TARGET_LS1088ARDB=y
# CONFIG_SYS_MALLOC_F is not set
CONFIG_FIT=y
CONFIG_FIT_VERBOSE=y
CONFIG_SYS_EXTRA_OPTIONS="LS1088A, EMU, SYS_FSL_DDR4"
CONFIG_HUSH_PARSER=y
CONFIG_CMD_I2C=y
# CONFIG_CMD_SETEXPR is not set
CONFIG_CMD_DHCP=y
CONFIG_CMD_PING=y
CONFIG_OF_CONTROL=y
CONFIG_NET_RANDOM_ETHADDR=y
CONFIG_NETDEVICES=y
CONFIG_E1000=y
CONFIG_SYS_NS16550=y
```

## u-boot/configs/ls1088aemu_qspi_defconfig
```kconfig
CONFIG_SYS_EXTRA_OPTIONS="LS1088A, EMU, QSPI_BOOT, SYS_FSL_DDR4"
CONFIG_ARM=y
CONFIG_TARGET_LS1088ARDB=y
CONFIG_NET_RANDOM_ETHADDR=y
CONFIG_NETDEVICES=y
CONFIG_E1000=y
CONFIG_SYS_NS16550=y
```

## u-boot/configs/ls1088aemu_sd_defconfig
```kconfig
CONFIG_SYS_EXTRA_OPTIONS="LS1088A, EMU, SD_BOOT, SYS_FSL_DDR4, ESDHC_DETECT_QUIRK"
CONFIG_ARM=y
CONFIG_TARGET_LS1088ARDB=y
CONFIG_NET_RANDOM_ETHADDR=y
CONFIG_NETDEVICES=y
CONFIG_E1000=y
CONFIG_SYS_NS16550=y
CONFIG_SPL=y
CONFIG_PARTITIONS=y
```

## u-boot/configs/ls1088ardb_defconfig
```kconfig
CONFIG_ARM=y
CONFIG_TARGET_LS1088ARDB=y
# CONFIG_SYS_MALLOC_F is not set
CONFIG_DEFAULT_DEVICE_TREE="fsl-ls1088a-rdb"
CONFIG_FIT=y
CONFIG_FIT_VERBOSE=y
CONFIG_SYS_EXTRA_OPTIONS="SYS_FSL_DDR4, LS1088A"
CONFIG_HUSH_PARSER=y
CONFIG_CMD_I2C=y
# CONFIG_CMD_SETEXPR is not set
CONFIG_CMD_DHCP=y
CONFIG_CMD_PING=y
CONFIG_OF_CONTROL=y
CONFIG_NET_RANDOM_ETHADDR=y
CONFIG_NETDEVICES=y
CONFIG_E1000=y
CONFIG_SYS_NS16550=y
```

## u-boot/configs/ls2080aqds_nand_defconfig
```kconfig
CONFIG_ARM=y
CONFIG_TARGET_LS2080AQDS=y
CONFIG_SPL=y
CONFIG_SYS_EXTRA_OPTIONS="SYS_FSL_DDR4,NAND, LS2080A"
CONFIG_DEFAULT_DEVICE_TREE="fsl-ls2080a-qds"
# CONFIG_SYS_MALLOC_F is not set
CONFIG_OF_CONTROL=y
CONFIG_SPL_DISABLE_OF_CONTROL=y
CONFIG_OF_EMBED=y
CONFIG_DM=y
CONFIG_DM_SPI_FLASH=y
CONFIG_DM_SPI=y
CONFIG_FSL_QSPI=y
# CONFIG_CMD_SETEXPR is not set
CONFIG_NETDEVICES=y
CONFIG_E1000=y
```

## u-boot/configs/ls2080aqds_qspi_defconfig
```kconfig
CONFIG_ARM=y
CONFIG_TARGET_LS2080AQDS=y
CONFIG_DEFAULT_DEVICE_TREE="fsl-ls2080a-qds"
CONFIG_SYS_EXTRA_OPTIONS="SYS_FSL_DDR4,QSPI_BOOT,LS2080A"
CONFIG_OF_CONTROL=y
CONFIG_DM=y
CONFIG_DM_SPI_FLASH=y
CONFIG_DM_SPI=y
CONFIG_FSL_QSPI=y
```
