## ISSD-SDK-20160701-yocto/LS2085A-SDK-20160304-yocto/meta-linaro/meta-aarch64/conf/machine/genericarmv8.conf
```bitbake
#@TYPE: Machine
#@NAME: generic armv8 machine
#@DESCRIPTION: generic machine to be used by linaro-media-create

require conf/machine/include/arm/arch-armv8.inc

PREFERRED_PROVIDER_virtual/xserver ?= "xserver-xorg"

XSERVER ?= "xserver-xorg \
            mesa-driver-swrast \
            xf86-input-evdev \
            xf86-input-mouse \
            xf86-video-fbdev \
            xf86-input-keyboard"

MACHINE_FEATURES = ""

# Don't include kernels in standard images
RDEPENDS_kernel-base = ""

PREFERRED_PROVIDER_virtual/kernel ?= "linux-linaro"

KERNEL_IMAGETYPE = "Image"

# We have to disable SERIAL_CONSOLE due to auto-serial-console
#SERIAL_CONSOLE = "115200 ttyAMA0"

# Force auto-serial-console to be used by all image types
# Ideally this would be part of core oe or as a bbclassappend,
# but as we don't have an easy way to append a class, defining
# it here
EXTRA_IMAGE_FEATURES += "autoserial"
FEATURE_PACKAGES_autoserial = "auto-serial-console"

# we do not want to have getty running on tty1 as we run
# auto-serial-console there
USE_VT = "0"
```

## ISSD-SDK-20160701-yocto/LS2085A-SDK-20160304-yocto/meta-linaro/meta-aarch64/conf/machine/genericarmv8b.conf
```bitbake
#@TYPE: Machine
#@NAME: generic armv8 big endian machine
#@DESCRIPTION: generic machine to be used by linaro-media-create
DEFAULTTUNE = "aarch64_be"

PREFERRED_PROVIDER_virtual/kernel ?= "linux-dummy"

require conf/machine/genericarmv8.conf
```

## ISSD-SDK-20160701-yocto/LS2085A-SDK-20160304-yocto/meta-linaro/meta-bigendian/conf/layer.conf
```bitbake
# We have a conf and classes directory, append to BBPATH
BBPATH .= ":${LAYERDIR}"

# We have a recipes directory, add to BBFILES
BBFILES += "${LAYERDIR}/recipes*/*/*.bb ${LAYERDIR}/recipes*/*/*.bbappend"

BBFILE_COLLECTIONS += "bigendian"
BBFILE_PATTERN_bigendian := "^${LAYERDIR}/"
BBFILE_PRIORITY_bigendian = "20"
```

## ISSD-SDK-20160701-yocto/LS2085A-SDK-20160304-yocto/meta-linaro/meta-ilp32/conf/layer.conf
```bitbake
BBPATH .= ":${LAYERDIR}"
BBFILES += "\
            ${LAYERDIR}/recipes*/*/*.bb \
            ${LAYERDIR}/recipes*/*/*.bbappend \
           "

BBFILE_COLLECTIONS += "ilp32"
BBFILE_PATTERN_ilp32 := "^${LAYERDIR}/"
BBFILE_PRIORITY_ilp32 = "20"

# do not error out on bbappends for missing recipes (mysql5)
BB_DANGLINGAPPENDS_WARNONLY = "true"

LAYERDEPENDS_ilp32 = "linaro linaro-toolchain"
```

## ISSD-SDK-20160701-yocto/LS2085A-SDK-20160304-yocto/meta-linaro/meta-ilp32/conf/machine/include/arm64/arch-armv8.inc
```bitbake
DEFAULTTUNE ?= "aarch64"

ARMPKGARCH ?= "aarch64"

TUNEVALID[aarch64] = "Enable instructions for aarch64"
TUNEVALID[bigendian] = "Enable big-endian mode."
TUNECONFLICTS[aarch64] = ""
MACHINEOVERRIDES .= "${@bb.utils.contains("TUNE_FEATURES", "aarch64", ":aarch64", "" ,d)}"

TUNEVALID[ilp32] = "Enable instructions for aarch64 32 bit mode"
#TUNECONFLICTS[ilp32] = "aarch64"
ABIEXTENSION .= "${@bb.utils.contains("TUNE_FEATURES", "ilp32", "ilp32", "" ,d)}"
TUNE_CCARGS .= "${@bb.utils.contains("TUNE_FEATURES", "ilp32", " -mabi=ilp32", "", d)}"
MACHINEOVERRIDES .= "${@bb.utils.contains("TUNE_FEATURES", "ilp32", ":aarchilp32", "" ,d)}"

# Little Endian base configs
AVAILTUNES += "aarch64 aarch64_be aarch64_ilp32 aarch64_be_ilp32"
TUNE_FEATURES_tune-aarch64 ?= "aarch64"
TUNE_FEATURES_tune-aarch64_be ?= "${TUNE_FEATURES_tune-aarch64} bigendian"
TUNE_FEATURES_tune-aarch64_ilp32 ?= "aarch64 ilp32"
TUNE_FEATURES_tune-aarch64_be_ilp32 ?= "${TUNE_FEATURES_tune-aarch64} bigendian ilp32"

ARMPKGSFX_ENDIAN = "${@bb.utils.contains("TUNE_FEATURES", "bigendian", "_be", "", d)}"
ARMPKGSFX_ILP32 = "${@bb.utils.contains("TUNE_FEATURES", "ilp32", "_ilp32", "", d)}"

TUNE_ARCH = "aarch64${ARMPKGSFX_ENDIAN}"
TUNE_PKGARCH = "aarch64${ARMPKGSFX_ENDIAN}${ARMPKGSFX_ILP32}"

PACKAGE_EXTRA_ARCHS = "aarch64${ARMPKGSFX_ENDIAN}${ARMPKGSFX_ILP32}"
```
