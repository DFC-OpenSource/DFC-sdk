## ISSD-SDK-20160701-yocto/LS2085A-SDK-20160304-yocto/meta-cloud-services/conf/layer.conf
```bitbake
# We have a conf and classes directory, append to BBPATH
BBPATH .= ":${LAYERDIR}"

# We have a recipes directory, add to BBFILES
BBFILES += "${LAYERDIR}/recipes*/*/*.bb ${LAYERDIR}/recipes*/*/*.bbappend"

BBFILE_COLLECTIONS += "cloud-services-layer"
BBFILE_PATTERN_cloud-services-layer := "^${LAYERDIR}/"
BBFILE_PRIORITY_cloud-services-layer = "5"
```

## ISSD-SDK-20160701-yocto/LS2085A-SDK-20160304-yocto/meta-cloud-services/meta-openstack-aio-deploy/conf/layer.conf
```bitbake
# We have a conf and classes directory, append to BBPATH
BBPATH .= ":${LAYERDIR}"

# We have a recipes directory, add to BBFILES
BBFILES += "${LAYERDIR}/recipes*/*/*.bb ${LAYERDIR}/recipes*/*/*.bbappend ${LAYERDIR}/classes/*.bbclass"

BBFILE_COLLECTIONS += "openstack-aio-deploy-layer"
BBFILE_PATTERN_openstack-aio-deploy-layer := "^${LAYERDIR}/"
BBFILE_PRIORITY_openstack-aio-deploy-layer = "6"
```

## ISSD-SDK-20160701-yocto/LS2085A-SDK-20160304-yocto/meta-cloud-services/meta-openstack-compute-deploy/conf/layer.conf
```bitbake
# We have a conf and classes directory, append to BBPATH
BBPATH .= ":${LAYERDIR}"

# We have a recipes directory, add to BBFILES
BBFILES += "${LAYERDIR}/recipes*/*/*.bb ${LAYERDIR}/recipes*/*/*.bbappend ${LAYERDIR}/classes/*.bbclass"

BBFILE_COLLECTIONS += "openstack-compute-deploy-layer"
BBFILE_PATTERN_openstack-compute-deploy-layer := "^${LAYERDIR}/"
BBFILE_PRIORITY_openstack-compute-deploy-layer = "6"
```

## ISSD-SDK-20160701-yocto/LS2085A-SDK-20160304-yocto/meta-cloud-services/meta-openstack-compute-test-config/conf/layer.conf
```bitbake
# We have a conf and classes directory, append to BBPATH
BBPATH .= ":${LAYERDIR}"

# We have a recipes directory, add to BBFILES
BBFILES += "${LAYERDIR}/recipes*/*/*.bb ${LAYERDIR}/recipes*/*/*.bbappend ${LAYERDIR}/classes/*.bbclass"

BBFILE_COLLECTIONS += "openstack-compute-test-config-layer"
BBFILE_PATTERN_openstack-compute-test-config-layer := "^${LAYERDIR}/"
# We want this layer to have higher priority than any other meta-openstack layers
BBFILE_PRIORITY_openstack-compute-test-config-layer = "100"
```

## ISSD-SDK-20160701-yocto/LS2085A-SDK-20160304-yocto/meta-cloud-services/meta-openstack-swift-deploy/conf/layer.conf
```bitbake
# We have a conf and classes directory, append to BBPATH
BBPATH .= ":${LAYERDIR}"

# We have a recipes directory, add to BBFILES
BBFILES += "${LAYERDIR}/recipes*/*/*.bb ${LAYERDIR}/recipes*/*/*.bbappend ${LAYERDIR}/classes/*.bbclass"

BBFILE_COLLECTIONS += "openstack-swift-deploy-layer"
BBFILE_PATTERN_openstack-swift-deploy-layer := "^${LAYERDIR}/"
BBFILE_PRIORITY_openstack-swift-deploy-layer = "6"
```

## ISSD-SDK-20160701-yocto/LS2085A-SDK-20160304-yocto/meta-cloud-services/meta-openstack/conf/distro/include/package_regex_openstack.inc
```bitbake
# package_regex_openstack.inc - This file contains data that tracks
# upstream project associated with a given recipe. This list is needed
# for recipes that version information can not be automagically discovered.
# As we automate this checking, this file will slowly be reduced.
#
# This data is used by the auto-upgrade-helper, to use it, you could
# add the following to your conf/local.conf:
#   --------------- snip ---------------
#   INHERIT =+ "distrodata"
#   require conf/distro/include/package_regex_openstack.inc
#   --------------- snip ---------------
#
# Fore more details about auto-upgrade-help, please refer to:
#   http://git.yoctoproject.org/cgit/cgit.cgi/auto-upgrade-helper/tree/README
#
# The format is as a bitbake variable override for each recipe
#
#       REGEX_URI_pn-<recipe name> = "recipe_url"
#	 - This is the url used by the package checking system to
#	   get the latest version of the package
#       REGEX_pn-<recipe name> = "package_regex"
#	 - This is the regex the package checking system uses to
#	   parse the page found at REGEX_URI_pn-<recipe name>
#

COMMON_REGEX = "(?P<pver>(\d+[\.-_]*)+)"

# PyPI sites
REGEX_URI_pn-python-cephclient = "https://pypi.python.org/pypi/python-cephclient/"
REGEX_pn-python-cephclient = "/python-cephclient/${COMMON_REGEX}"
REGEX_URI_pn-python-hp3parclient = "https://pypi.python.org/pypi/hp3parclient/"
REGEX_pn-python-hp3parclient = "/hp3parclient/${COMMON_REGEX}"
REGEX_URI_pn-python-openstackclient = "https://pypi.python.org/pypi/python-openstackclient/"
REGEX_pn-python-openstackclient = "/python-openstackclient/${COMMON_REGEX}"

# GIT
GITTAGREGEX_COMMON = "(?P<pver>\d+\.\d+\.(\d\.?)*)"

GITTAGREGEX_pn-python-glanceclient = "${GITTAGREGEX_COMMON}"
GITTAGREGEX_pn-python-keystoneclient = "${GITTAGREGEX_COMMON}"
GITTAGREGEX_pn-python-neutronclient = "(?P<pver>\d+\.\d+\.(\d\.?)+)"
GITTAGREGEX_pn-python-novaclient = "${GITTAGREGEX_COMMON}"

GITTAGREGEX_BETA = "(?P<pver>\d+\.\d+(\.\d+(b\d)?)?)"
GITTAGREGEX_pn-python-barbican = "${GITTAGREGEX_BETA}"
GITTAGREGEX_pn-python-ceilometer = "${GITTAGREGEX_BETA}"
GITTAGREGEX_pn-python-cinder = "${GITTAGREGEX_BETA}"
GITTAGREGEX_pn-python-glance = "${GITTAGREGEX_BETA}"
GITTAGREGEX_pn-python-heat = "${GITTAGREGEX_BETA}"
GITTAGREGEX_pn-python-horizon = "${GITTAGREGEX_BETA}"
GITTAGREGEX_pn-python-keystone = "${GITTAGREGEX_BETA}"
GITTAGREGEX_pn-python-neutron = "${GITTAGREGEX_BETA}"
GITTAGREGEX_pn-python-nova = "${GITTAGREGEX_BETA}"
```

## ISSD-SDK-20160701-yocto/LS2085A-SDK-20160304-yocto/meta-cloud-services/meta-openstack/conf/layer.conf
```bitbake
# We have a conf and classes directory, append to BBPATH
BBPATH .= ":${LAYERDIR}"

# We have a recipes directory, add to BBFILES
BBFILES += "${LAYERDIR}/recipes*/*/*.bb ${LAYERDIR}/recipes*/*/*.bbappend"

BBFILE_COLLECTIONS += "openstack-layer"
BBFILE_PATTERN_openstack-layer := "^${LAYERDIR}/"
BBFILE_PRIORITY_openstack-layer = "5"

BB_DANGLINGAPPENDS_WARNONLY ?= "true"

# pre 0.4.0 greenlet versions segfault python
PREFERRED_VERSION_python-greenlet = "0.4.1"
PREFERRED_VERSION_python-sqlalchemy = "0.9.7"
PREFERRED_VERSION_python-pexpect = "3.3"
PREFERRED_VERSION_python-six = "1.9.0"
PREFERRED_VERSION_python-psutil = "1.2.1"
```

## ISSD-SDK-20160701-yocto/LS2085A-SDK-20160304-yocto/meta-fsl-arm/conf/machine/include/ls1088a-base.inc
```bitbake
require conf/machine/include/soc-family.inc
require conf/machine/include/arm/arch-arm64.inc

# Freescale BSP default providers
PREFERRED_PROVIDER_u-boot ?= "u-boot-ls1088a"
PREFERRED_PROVIDER_virtual/kernel ?= "linux-ls1088a-sdk"

# Define the default image type
IMAGE_CLASSES ?= "image_types_uboot"
KERNEL_IMAGETYPE ?= "Image"

MACHINE_FEATURES = "pci ext2 ext3 serial"
MACHINE_EXTRA_RRECOMMENDS = "udev-extraconf"
```

## ISSD-SDK-20160701-yocto/LS2085A-SDK-20160304-yocto/meta-fsl-arm/conf/machine/include/ls2-base.inc
```bitbake
require conf/machine/include/soc-family.inc
require conf/machine/include/arm/arch-arm64.inc

# Freescale BSP default providers
PREFERRED_PROVIDER_u-boot ?= "u-boot-ls2"
PREFERRED_PROVIDER_virtual/kernel ?= "linux-ls2-sdk"
PREFERRED_PROVIDER_libevent ?= "libevent"

# Define the default image type
IMAGE_CLASSES ?= "image_types_uboot"
KERNEL_IMAGETYPE ?= "Image"

MACHINE_FEATURES = "pci ext2 ext3 serial"
MACHINE_EXTRA_RRECOMMENDS = "udev-extraconf"

EXTRA_IMAGEDEPENDS += "cst-native"
```

## ISSD-SDK-20160701-yocto/LS2085A-SDK-20160304-yocto/meta-fsl-arm/conf/machine/ls1088ardb.conf
```bitbake
#@TYPE: Machine
#@NAME: Freescale LS1088ARDB Board
#@SOC: FSL-LSCH3
#@DESCRIPTION: Machine configuration for running LS1088ARDB in 64-bit mode
#@MAINTAINER: Zongchun Yu <Zongchun.Yu@freescale.com>

require conf/machine/include/ls1088a-base.inc

SOC_FAMILY = "fsl-lsch3"
UBOOT_CONFIG ??= "nor"
UBOOT_CONFIG[nor] = "ls1088ardb_defconfig"
KERNEL_DEVICETREE ?= "freescale/fsl-ls1088a-rdb.dtb"
KERNEL_DEFCONFIG ?= "${S}/arch/arm64/configs/defconfig"
KERNEL_ITS_FILE = "kernel-ls1088a-rdb.its"

SERIAL_CONSOLES ?= "115200;ttyS0 115200;ttyS1 115200;ttyAMA0"
SERIAL_CONSOLES_CHECK ?= "${SERIAL_CONSOLES}"
USE_VT = "0"
```

## ISSD-SDK-20160701-yocto/LS2085A-SDK-20160304-yocto/meta-fsl-arm/conf/machine/ls2080ardb.conf
```bitbake
#@TYPE: Machine
#@NAME: Freescale LS2080ARDB board
#@SOC: LSCH3
#@DESCRIPTION: Machine configuration for running LS2080ARDB in 64-bit mode
#@MAINTAINER: Zongchun Yu <Zongchun.Yu@freescale.com>

require conf/machine/include/ls2-base.inc

SOC_FAMILY = "fsl-lsch3"
UBOOT_CONFIG ??= "nor"
UBOOT_CONFIG[nor] = "ls2080ardb_defconfig"
KERNEL_DEVICETREE ?= "freescale/fsl-ls2080a-rdb.dtb"
KERNEL_DEFCONFIG ?= "${S}/arch/arm64/configs/defconfig"
KERNEL_ITS_FILE = "kernel2080-rdb.its"

SERIAL_CONSOLES ?= "115200;ttyS0 115200;ttyS1 115200;ttyAMA0"
SERIAL_CONSOLES_CHECK ?= "${SERIAL_CONSOLES}"
USE_VT = "0"
```

## ISSD-SDK-20160701-yocto/LS2085A-SDK-20160304-yocto/meta-fsl-arm/conf/machine/ls2085aissd.conf
```bitbake
#@TYPE: Machine
#@NAME: Freescale LS2085AISSD board
#@SOC: LSCH3
#@DESCRIPTION: Machine configuration for running LS2085AISSD in 64-bit mode
#@MAINTAINER: Zongchun Yu <Zongchun.Yu@freescale.com>

require conf/machine/include/ls2-base.inc

SOC_FAMILY = "fsl-lsch3"
UBOOT_CONFIG ??= "nor"
UBOOT_CONFIG[nor] = "ls2085aissd_defconfig"
KERNEL_DEVICETREE ?= "freescale/fsl-ls2085a-issd.dtb"
KERNEL_DEFCONFIG ?= "${S}/arch/arm64/configs/ls2085a_issdconfig"
KERNEL_ITS_FILE = "kernel-issd.its"

SERIAL_CONSOLES ?= "115200;ttyS0 115200;ttyS1 115200;ttyAMA0"
SERIAL_CONSOLES_CHECK ?= "${SERIAL_CONSOLES}"
USE_VT = "0"
```

## ISSD-SDK-20160701-yocto/LS2085A-SDK-20160304-yocto/meta-fsl-arm/conf/machine/ls2085aqds.conf
```bitbake
#@TYPE: Machine
#@NAME: Freescale LS2085AQDS board
#@SOC: LSCH3
#@DESCRIPTION: Machine configuration for running LS2085AQDS in 64-bit mode
#@MAINTAINER: Zongchun Yu <Zongchun.Yu@freescale.com>

require conf/machine/include/ls2-base.inc

SOC_FAMILY = "fsl-lsch3"
UBOOT_CONFIG ??= "nor"
UBOOT_CONFIG[nor] = "ls2085aqds_defconfig"
KERNEL_DEVICETREE ?= "freescale/fsl-ls2085a-qds.dtb"
KERNEL_DEFCONFIG ?= "${S}/arch/arm64/configs/defconfig"
KERNEL_ITS_FILE = "kernel-qds.its"

SERIAL_CONSOLES ?= "115200;ttyS0 115200;ttyS1 115200;ttyAMA0"
SERIAL_CONSOLES_CHECK ?= "${SERIAL_CONSOLES}"
USE_VT = "0"
```

## ISSD-SDK-20160701-yocto/LS2085A-SDK-20160304-yocto/meta-fsl-arm/conf/machine/ls2085ardb.conf
```bitbake
#@TYPE: Machine
#@NAME: Freescale LS2085ARDB board
#@SOC: LSCH3
#@DESCRIPTION: Machine configuration for running LS2085ARDB in 64-bit mode
#@MAINTAINER: Zongchun Yu <Zongchun.Yu@freescale.com>

require conf/machine/include/ls2-base.inc

SOC_FAMILY = "fsl-lsch3"
UBOOT_CONFIG ??= "nor"
UBOOT_CONFIG[nor] = "ls2085ardb_defconfig"
KERNEL_DEVICETREE ?= "freescale/fsl-ls2085a-rdb.dtb"
KERNEL_DEFCONFIG ?= "${S}/arch/arm64/configs/defconfig"
KERNEL_ITS_FILE = "kernel-rdb.its"

SERIAL_CONSOLES ?= "115200;ttyS0 115200;ttyS1 115200;ttyAMA0"
SERIAL_CONSOLES_CHECK ?= "${SERIAL_CONSOLES}"
USE_VT = "0"
```

## ISSD-SDK-20160701-yocto/LS2085A-SDK-20160304-yocto/meta-fsl-arm/conf/machine/ls2088a-simu.conf
```bitbake
#@TYPE: Machine
#@NAME: Freescale LS2088A Simulator
#@SOC: LSCH3
#@DESCRIPTION: Machine configuration for running LS2088A Simulator in 64-bit mode
#@MAINTAINER: Zongchun Yu <Zongchun.Yu@freescale.com>

require conf/machine/include/ls2-base.inc

SOC_FAMILY = "fsl-lsch3"
UBOOT_CONFIG ??= "nor"
UBOOT_CONFIG[nor] = "ls2088a_simu_defconfig"
KERNEL_DEVICETREE ?= "freescale/fsl-ls2088a-simu.dtb"
KERNEL_DEFCONFIG ?= "${S}/arch/arm64/configs/defconfig"
KERNEL_ITS_FILE = "kernel-simu.its"

SERIAL_CONSOLES ?= "115200;ttyS0 115200;ttyS1 115200;ttyAMA0"
SERIAL_CONSOLES_CHECK ?= "${SERIAL_CONSOLES}"
USE_VT = "0"
```

## ISSD-SDK-20160701-yocto/LS2085A-SDK-20160304-yocto/meta-fsl-networking/conf/distro/fsl-networking.conf
```bitbake
require conf/distro/poky.conf

DISTRO = "fsl-networking"
SDK_VENDOR = "-fsl"
SDK_VERSION = "LS2085A-SDK"
MAINTAINER = "Freescale Yocto Team <yocto@linux.freescale.net>"

TARGET_VENDOR = "-fsl"

SDK_NAME = "${DISTRO}-${TCLIBC}-${SDK_ARCH}-${TUNE_PKGARCH}"

SANITY_TESTED_DISTROS += " \
            CentOS-7.1.1503 \n \
            Debian-8.2 \n \
            Fedora-22 \n \
            LinuxMint-15 \n \
            SUSE-LINUX-13.2 \n \
            Ubuntu-14.04 \n \
        "
include conf/distro/include/ls2-networking-base.inc
include conf/distro/include/fsl-networking-sha-references.inc
include conf/include/fsl-toolchain-default-version.inc

INHERIT += "own-mirrors"
SOURCE_MIRROR_URL ?= "http://autobuilder.yoctoproject.org/sources/"

INSANE_SKIP_issd-nvme = "installed-vs-shipped"

DISTRO_FEATURES_DEFAULT_append = " benchmark ext2 mtd alsa perl ppp python usbhost virtualization db"

ERROR_QA = "dev-so debug-deps dev-deps debug-files arch la2 pkgconfig la perms rpaths staticdev ldflags"
```

## ISSD-SDK-20160701-yocto/LS2085A-SDK-20160304-yocto/meta-fsl-networking/conf/distro/include/ls2-networking-base.inc
```bitbake
# Provides the base settings for LS2

GCCVERSION = "linaro-4.9"
BINUVERSION = "linaro-2.25"
PREFERRED_VERSION_glibc = "linaro-2.20"
PREFERRED_VERSION_glibc-initial = "linaro-2.20"
PREFERRED_VERSION_glibc-locale = "linaro-2.20"
PREFERRED_VERSION_glibc-mtrace = "linaro-2.20"
PREFERRED_VERSION_nativesdk-glibc = "linaro-2.20"
PREFERRED_VERSION_quagga = "0.99.9+fslgit"
PREFERRED_VERSION_qemu = "2.4+fsl"
PREFERRED_VERSION_openvswitch = "2.3.0"
PREFERRED_VERSION_python-sqlalchemy = "1.0.8"
PREFERRED_VERSION_cryptodev = "1.7"
PREFERRED_VERSION_docker = "1.9.0%"
PREFERRED_VERSION_odp = "1.4"
```

## ISSD-SDK-20160701-yocto/LS2085A-SDK-20160304-yocto/meta-fsl-networking/conf/layer.conf
```bitbake
BBPATH .= ":${LAYERDIR}"
BBFILES += "\
            ${LAYERDIR}/classes/*.bb* \
            ${LAYERDIR}/images/*.bb \
            ${LAYERDIR}/packagegroups/*.bb* \
            ${LAYERDIR}/recipes*/*/*.bb* \
           "

BBFILE_COLLECTIONS += "fsl-networking"
BBFILE_PATTERN_fsl-networking := "^${LAYERDIR}/"
BBFILE_PRIORITY_fsl-networking = "5"

LICENSE_PATH += "${LAYERDIR}/custom-licenses"

# Let us add layer-specific bbappends which are only applied when that
# layer is included in our configuration
BBFILES += "${@' '.join('${LAYERDIR}/recipes*/%s/*/*.bbappend' % layer \
              for layer in BBFILE_COLLECTIONS.split())}"


# Let us add layer-specific bb which are only applied when that
# layer is included in our configuration
BBFILES += "${@' '.join('${LAYERDIR}/recipes*/%s/*/*.bb' % layer \
              for layer in BBFILE_COLLECTIONS.split())}"
```

## ISSD-SDK-20160701-yocto/LS2085A-SDK-20160304-yocto/meta-fsl-toolchain/conf/layer.conf
```bitbake
# We have a packages directory, add to BBFILES
BBPATH := "${BBPATH}:${LAYERDIR}"

BBFILES += "${LAYERDIR}/recipes-*/*/*.bb*"

BBFILE_COLLECTIONS += "meta-fsl-toolchain"
BBFILE_PATTERN_meta-fsl-toolchain := "^${LAYERDIR}/"
BBFILE_PRIORITY_meta-fsl-toolchain = "5"
```

## ISSD-SDK-20160701-yocto/LS2085A-SDK-20160304-yocto/meta-linaro/meta-aarch64/conf/layer.conf
```bitbake
BBPATH .= ":${LAYERDIR}"
BBFILES += "\
            ${LAYERDIR}/recipes*/*/*.bb \
            ${LAYERDIR}/recipes*/*/*.bbappend \
           "

BBFILE_COLLECTIONS += "aarch64"
BBFILE_PATTERN_aarch64 := "^${LAYERDIR}/"
BBFILE_PRIORITY_aarch64 = "20"

# do not error out on bbappends for missing recipes (mysql5)
BB_DANGLINGAPPENDS_WARNONLY = "true"

LAYERDEPENDS_aarch64 = "linaro linaro-toolchain"
```
